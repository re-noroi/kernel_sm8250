## drivers/android/Kconfig
```kconfig
# SPDX-License-Identifier: GPL-2.0
menu "Android"
config ANDROID
	bool "Android Drivers"
	help
	  Enable support for various drivers needed on the Android platform
if ANDROID
config ANDROID_BINDER_IPC
	bool "Android Binder IPC Driver"
	depends on MMU
	default n
	help
	  Binder is used in Android for both communication between processes,
	  and remote method invocation.
	  This means one Android process can call a method/routine in another
	  Android process, using Binder to identify, invoke and pass arguments
	  between said processes.
config ANDROID_BINDERFS
	bool "Android Binderfs filesystem"
	depends on ANDROID_BINDER_IPC
	default n
	help
	  Binderfs is a pseudo-filesystem for the Android Binder IPC driver
	  which can be mounted per-ipc namespace allowing to run multiple
	  instances of Android.
	  Each binderfs mount initially only contains a binder-control device.
	  It can be used to dynamically allocate new binder IPC devices via
	  ioctls.
config ANDROID_BINDER_DEVICES
	string "Android Binder devices"
	depends on ANDROID_BINDER_IPC
	default "binder,hwbinder,vndbinder"
	help
	  Default value for the binder.devices parameter.
	  The binder.devices parameter is a comma-separated list of strings
	  that specifies the names of the binder device nodes that will be
	  created. Each binder device has its own context manager, and is
	  therefore logically separated from the other devices.
config ANDROID_BINDER_IPC_SELFTEST
	bool "Android Binder IPC Driver Selftest"
	depends on ANDROID_BINDER_IPC
	help
	  This feature allows binder selftest to run.
	  Binder selftest checks the allocation and free of binder buffers
	  exhaustively with combinations of various buffer sizes and
	  alignments.
config ANDROID_DEBUG_SYMBOLS
	bool "Android Debug Symbols"
	help
	  Enables export of debug symbols that are useful for offline debugging
	  of a kernel. These symbols would be used in vendor modules to find
	  addresses of the core kernel symbols for vendor extensions.
	  This driver is statically compiled into kernel and maintains all the
	  required symbol addresses for vendor modules and provides necessary
	  interface vendor modules.
config ANDROID_VENDOR_HOOKS
	bool "Android Vendor Hooks"
	depends on TRACEPOINTS
	help
	  Enable vendor hooks implemented as tracepoints
	  Allow vendor modules to attach to tracepoint "hooks" defined via
	  DECLARE_HOOK or DECLARE_RESTRICTED_HOOK.
config ANDROID_STRUCT_PADDING
	bool "Android Struct Padding"
	default y
	help
	  This option enables the padding that the Android GKI kernel adds
	  to many different kernel structures to support an in-kernel stable ABI
	  over the lifespan of support for the kernel as well as OEM additional
	  fields that are needed by some of the Android kernel tracepoints.
	  Only disable this option if you have a system that needs the Android
	  kernel drivers, but is NOT an Android GKI kernel image and you do NOT
	  use the Android kernel tracepoints. If disabled it has the possibility
	  to make the kernel static and runtime image slightly smaller but will
	  NOT be supported by the Google Android kernel team.
	  If even slightly unsure, say Y.

config ANDROID_BINDER_LOGS
	bool "Android Binder Logging"
	depends on ANDROID_BINDERFS
	help
	  Enables binder_logs directory in binderfs and debug_mask for dmesg
	  logging. Needed for DEBUG_FS.
	  This option impacts performance.

	  Say N on production builds.

config ANDROID_SIMPLE_LMK
	bool "Simple Android Low Memory Killer"
	depends on !ANDROID_LOW_MEMORY_KILLER && !MEMCG && PSI
	---help---
	  This is a complete low memory killer solution for Android that is
	  small and simple. Processes are killed according to the priorities
	  that Android gives them, so that the least important processes are
	  always killed first. Processes are killed until memory deficits are
	  satisfied, as observed from PSI stall notifications.

if ANDROID_SIMPLE_LMK

config ANDROID_SIMPLE_LMK_TIMEOUT_MSEC
	int "Reaper retry deadline in milliseconds"
	range 50 1000
	default 200
	help
	  The reaper thread reaps victims' page tables via mmap_read_trylock.
	  If a victim's mmap_lock is held by another thread, the reaper retries
	  with a one-jiffy sleep. This option bounds how long the reaper retries
	  a stuck victim before giving up (marking it OOM_SKIP and letting
	  exit_mmap handle the teardown). Lower values unblock the reaper
	  sooner under contention; higher values give the lock holder more time.

config ANDROID_SIMPLE_LMK_PSI_WINDOW_MS
	int "PSI polling window size in milliseconds"
	default 1000
	help
	  PSI polling window size in milliseconds.

config ANDROID_SIMPLE_LMK_PSI_THRESHOLD_LOW_US
	int "PSI MEM_FULL stall threshold for tier-0 kills"
	default 50000
	help
	  PSI MEM_FULL stall threshold (µs/window) for tier-0 kills
	  (cached processes only, adj >= 800).

config ANDROID_SIMPLE_LMK_PSI_THRESHOLD_MED_US
	int "PSI MEM_FULL stall threshold for tier-1 kills"
	default 100000
	help
	  Stall threshold (µs/window) for tier-1 kills (adj >= 200).

config ANDROID_SIMPLE_LMK_PSI_THRESHOLD_HIGH_US
	int "PSI MEM_FULL stall threshold for tier-2 kills"
	default 150000
	help
	  Stall threshold (µs/window) for tier-2 kills (adj >= 1).

config ANDROID_SIMPLE_LMK_DECAY_FULL_SEC
	int "Time-decay threshold for full (100%) anon-page weight"
	range 10 600
	default 60
	help
	  Time in seconds an app must remain backgrounded (adj >= 800) before
	  its anonymous pages are counted at 100% weight for victim sizing.
	  Apps backgrounded longer than this threshold are considered cold.

config ANDROID_SIMPLE_LMK_DECAY_HALF_SEC
	int "Time-decay threshold for half (50%) anon-page weight"
	range 5 300
	default 30
	help
	  Time in seconds an app must remain backgrounded (adj >= 800) before
	  its anonymous pages are counted at 50% weight. Must be less than
	  DECAY_FULL_SEC. Apps backgrounded between this and DECAY_FULL_SEC
	  are counted at 50%; below this, at 25%.

config ANDROID_SIMPLE_LMK_DECAY_HOT_SHIFT
	int "Right-shift for hot (recently cached) anon-page weight"
	range 1 4
	default 2
	help
	  Right-shift applied to anonymous pages for apps that were recently
	  backgrounded (below the DECAY_HALF_SEC threshold) or have no
	  cache_time. A shift of 2 gives 25% weight, 3 gives 12.5%, etc.

endif

config ANDROID_KABI_RESERVE
	bool "Android KABI reserve padding"
	default n
	help
	  This option enables the padding that the Android GKI kernel adds
	  to many different kernel structures to support an in-kernel stable ABI
	  over the lifespan of support for the kernel.

	  Only disable this option if you have a system that needs the Android
	  kernel drivers, but is NOT an Android GKI kernel image. If disabled
	  it has the possibility to make the kernel static and runtime image
	  slightly smaller but will NOT be supported by the Google Android
	  kernel team.

	  If even slightly unsure, say Y.

endif # if ANDROID
endmenu
```
