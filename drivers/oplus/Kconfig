## drivers/oplus/Kconfig
```kconfig
# SPDX-License-Identifier: GPL-2.0-only
# Copyright (C) 2018-2020 Oplus. All rights reserved.

config OPLUS_OPROJECT
	bool "oplus project"
	default n
	help
	 define this config to define oplus project
	  
config OPLUS_NANDSWAP
	bool "nandswap feature"
	default n
	help
	 nandswap feature

config OPLUS_NANDSWAP_DEBUG
	bool "nandswap debug"
	depends on F2FS_FS
	default n
	help
	 nandswap debug

config OPLUS_NWPOWER
    bool "OPLUS NWPOWER"
    default n
    help
	 add for oplus wakelock_profiler

config OPLUS_SUBSYS_SLEEP_MONITOR
	bool "monitor Qualcomm subsystem sleep"
	default n
	help
	  This selects to get sleep info for Qualcomm subsystem

config OPLUS_WAKELOCK_PROFILER
	bool "config oplus wakelock profiler"
	default n
	help
		Select this config to enable oplus wakelock profiler

config OPLUS_POWERINFO_STANDBY_DEBUG
	bool "powerinfo standby config"
	default n
	help
		Select this config to enable powerinfo standby debug

config OPLUS_POWERINFO_RPMH
	bool "powerinfo rpmh config"
	default n
	help
		Select this config to enable powerinfo rpmh

config OPLUS_POWERINFO_FTM
	bool "powerinfo ftm config"
	default n
	help
		Select this config to enable powerinfo ftm
```

## techpack/Kconfig
```kconfig
config OSSFOD
	bool "OSS FOD support"
	depends on BOARD_XIAOMI
	help
	  When this option is enabled, OSS FOD support will be added.

config TECHPACK_CAMERA_XIAOMI
    bool "Xiaomi camera"
    help
      Xiaomi camera

config TECHPACK_CAMERA_XIAOMI_CAS
    bool "Xiaomi camera CAS"
    help
      Xiaomi camera CAS

config TECHPACK_CAMERA_XIAOMI_LMI
    bool "Xiaomi camera LMI"
    help
      Xiaomi camera LMI

config TECHPACK_CAMERA_XIAOMI_TABLET
    bool "Xiaomi camera tablet"
    help
      Xiaomi camera tablet
```

## techpack/data/drivers/rmnet/shs/Kconfig
```kconfig
#
# RMNET_SHS driver
#

config RMNET_SHS
    bool "Rmnet SHS driver"
    default n
    depends on RMNET
    help
      performance mode of rmnet driver
```
